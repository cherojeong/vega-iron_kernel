## arch/arm/mach-msm/sky/Kconfig
```kconfig
config MACH_SKY
	bool

menu "SKY Board Selection"
source "arch/arm/mach-msm/sky/Kconfig.board"
endmenu


menu "Pantech / SKY Specific Patches"

config SKY_CRASH_HANDLER
	tristate "Support SKY/PANTECH Crash Handler"
	depends on !S390 && !UML && HAVE_MEMBLOCK && MSM_DLOAD_MODE
	select ANDROID_PERSISTENT_RAM
	default n
	help
	  SKY/PANTECH Crash Handler by cherojeong@gmail.com

config SKY_SERIAL_MSM_GSBI5_SUPPORT
	tristate "Support MSM Serial Console using GSBI5 Port."
	depends on SERIAL_MSM_HSL_CONSOLE
	default n
	help
	  SKY/PANTECH Serial Console Support by cherojeong@gmail.com

menu "USB Specific Configuration"
source "arch/arm/mach-msm/sky/Kconfig.usb"
endmenu

menu "CAMERA Specific Configuration"
source "arch/arm/mach-msm/sky/Kconfig.camera"
endmenu

endmenu
```

## arch/arm/mach-msm/sky/Kconfig.board
```kconfig
# Inlcude the specific Kconfig file for SKY board
#
# VEGA(UBUNTU)
source "arch/arm/mach-msm/sky/vega/Kconfig"

config MACH_SKY_DUMMY
	bool "NONE (No device)"
```

## arch/arm/mach-msm/sky/Kconfig.camera
```kconfig
config PANTECH_CAMERA
	bool "Camera Common Support Function"
	select PANTECH_CAMERA_SENSOR
	default y
	help
		VEGA(SKY) Camera Sensor Support Function & Feature

config PANTECH_CAMERA_TUNER
	bool "Camera Tune Function"
	default n
	help
		Common Tune Camera parameter function Support.

config PANTECH_CAMERA_SENSOR
	bool "VEGA(SKY) Camera Common Funcion I2C & Control for Sensors"
	default n
	help
		Common Sensor Control & Sensor I2C Function for Sensors.
```

## arch/arm/mach-msm/sky/Kconfig.usb
```kconfig
# USB Specific Configuration Support Kconfig

config PANTECH_ANDROID_OTG
	tristate "Support SKY/Pantech Android OTG"
	depends on USB_G_ANDROID
	default n
	help
	  SKY/Pantech Android USB OTG Specific function support

config ANDROID_PANTECH_USB_OTG_INTENT
	depends on PANTECH_ANDROID_OTG
	bool "USB OTG Intent Support"
	default y
	help
		Support Pantech USB OTG Intent

config PANTECH_ANDROID_USB
	tristate "USB Function Driver support"
	default y
	help
		Say "y" to link the driver statically, or "m" to build
		as a part of "g_android"	

config PANTECH_ANDROID_MTP
	tristate "Storage Gadget USB MTP Function Support"
	default y
	help
		Say "y" to link the driver statically, or "m" to build
		as a part of "g_android"

config PANTECH_ANDROID_OBEX
	tristate "Serial Gadget USB OBEX Function Support"
	default y
	help
		Say "y" to link the driver statically, or "m" to build
		as a part of "g_android"

config PANTECH_USB_TUNE_SIGNALING_PARAM
	bool "USB PHY Parameter tuning Support"
	default y
	help
		Support USB tuning.

config PANTECH_ANDROID_FACTORY_MODE
	bool "Composite Factory Mode for Pantech USB Driver"
	default y
	help 		
		Support Pantech Factory Mode USB Driver.
```

## arch/arm/mach-msm/sky/vega/Kconfig
```kconfig
config MACH_APQ8064_VEGA
	depends on ARCH_APQ8064
	select MACH_SKY
	bool "MSM8064 VEGA(UBUNTU)"
	help
	  Support for the SKY VEGA SERIES device.
	  For Porting Ubuntu Touch Developer Preview.
	  Created by cherojeong@gmail.com
```
